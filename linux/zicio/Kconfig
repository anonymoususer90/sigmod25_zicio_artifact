## linux/zicio/Kconfig
```kconfig
# SPDX-License-Identifier: GPL-2.0-only
menuconfig ZICIO
	tristate "ZicIO"
	depends on HAS_IOMEM && HAS_DMA && PCI
	help
	  Enable zicio

if ZICIO
config ZICIO_STAT
	bool "Whether or not to collect stat informations"
	default n
	help
		Gather detailed information on the operation of ZicIO
config ZICIO_DEBUG_LEVEL
	int "How detailed the debug messages will be printed"
	default 0
	help
		The levels consist of 0, 1, and 2
config ZICIO_OPTIMIZE_SHARED_MODE
	bool "Key optimizations made for sharing"
	default y
	help
		It works even if this is turned off, but the performance is poor
config ZICIO_PREAD_BREAKDOWN_LEVEL
	int "How detailed the breakdown of the read/pread syscall should be"
	default 0
	help
		The levels consist of 0, 1, and 2
endif
```
